## sdkconfig.defaults
```kconfig
# ESP32-S3M-N16R8: 16MB Flash + 8MB PSRAM
CONFIG_IDF_TARGET="esp32s3"

# Flash 容量 16MB
CONFIG_ESPTOOLPY_FLASHSIZE_16MB=y
CONFIG_ESPTOOLPY_FLASHSIZE="16MB"

# 单 APP 大分区表，便于后续加入 WiFi/LCD 等组件
CONFIG_PARTITION_TABLE_SINGLE_APP_LARGE=y

# 日志：默认 INFO，串口 115200
CONFIG_LOG_DEFAULT_LEVEL_INFO=y

# 需要时再打开 8MB Octal PSRAM（会占用 GPIO33~37）
# CONFIG_SPIRAM=y
# CONFIG_SPIRAM_MODE_OCT=y
# CONFIG_SPIRAM_SPEED_80M=y

# FatFS：支持长文件名，便于存放 WiFi 配置等文件
CONFIG_FATFS_LFN_HEAP=y
CONFIG_FATFS_MAX_LFN=255
```
